## meta-app/conf/layer.conf
```bitbake
# We have a conf and classes directory, add to BBPATH
BBPATH .= ":${LAYERDIR}"

# We have recipes-* directories, add to BBFILES
BBFILES += "${LAYERDIR}/recipes-*/*/*.bb \
            ${LAYERDIR}/recipes-*/*/*.bbappend"

BBFILE_COLLECTIONS += "meta-app"
BBFILE_PATTERN_meta-app = "^${LAYERDIR}/"
BBFILE_PRIORITY_meta-app = "6"

LAYERDEPENDS_meta-app = "core"
LAYERSERIES_COMPAT_meta-app = "warrior"
```

## meta-zero-distro/conf/distro/zero-distro.conf
```bitbake
require conf/distro/poky.conf

DISTRO = "zero"
DISTRO_NAME = "zero distribution"
DISTRO_VERSION = "1.0"
DISTRO_CODENAME = "zero"

## Enable wifi
# DISTRO_FEATURES_append = " wifi"

MACHINE = "raspberrypi0-wifi"

## Enable systemd
# use systemd as init manager
DISTRO_FEATURES_append = " systemd"
VIRTUAL-RUNTIME_init_manager = "systemd"
# prevent the SysVinit distribution feature from being automatically enabled
DISTRO_FEATURES_BACKFILL_CONSIDERED = "sysvinit"
# remove initscripts from the image altogether
VIRTUAL-RUNTIME_initscripts = ""
```
